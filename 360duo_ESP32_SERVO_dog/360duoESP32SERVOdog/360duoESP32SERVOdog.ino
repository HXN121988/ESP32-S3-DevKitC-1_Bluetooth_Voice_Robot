#include <ESP32Servo.h>
#include <HardwareSerial.h>
#include <Wire.h>
#include <Adafruit_GFX.h>
#include <Adafruit_SSD1306.h>

// ==================== OLED屏幕配置 ====================
#define SCREEN_WIDTH 128
#define SCREEN_HEIGHT 64
#define OLED_RESET     -1
#define OLED_ADDR       0x3C

// ==================== 舵机引脚定义（与原接线完全一致） ====================
const int servoPinFrontLeft  = 2;   // 前左舵机
const int servoPinFrontRight = 14;  // 前右舵机
const int servoPinBackLeft   = 3;   // 后左舵机
const int servoPinBackRight  = 13;  // 后右舵机

// ==================== 串口配置 ====================
const int uart1TxPin = 15;
const int uart1RxPin = 16;
const int uart2TxPin = 17;
const int uart2RxPin = 18;
const long uart1BaudRate = 9600;
const long uart2BaudRate = 115200;

// ==================== 蓝牙缓冲区配置（对齐STM32 BlueSerial逻辑） ====================
#define BLUE_SERIAL_BUFFER_SIZE   100
uint8_t BlueSerial_Buffer[BLUE_SERIAL_BUFFER_SIZE];
uint16_t BlueSerial_PutIndex = 0;
uint16_t BlueSerial_GetIndex = 0;
char BlueSerial_String[100];
char BlueSerial_StringArray[6][20];  // 最多分割6段参数

// ==================== 360°舵机转速参数 ====================
// 说明：90为停止；0-89为正转，数值越小转速越快；91-180为反转，数值越大转速越快
// 因左右舵机镜像安装，前进时左右转向相反，轮子才能同向滚动
//舵机停止值（校准后填入）
const int STOP_SPEED    = 95;   
const int LEFT_FORWARD  = 80;   // 左侧舵机前进转速
const int LEFT_BACK     = 100;  // 左侧舵机后退转速
const int RIGHT_FORWARD = 100;  // 右侧舵机前进转速
const int RIGHT_BACK    = 80;   // 右侧舵机后退转速

// ==================== 摇杆参数 ====================
const int JOYSTICK_DEAD_ZONE = 10; // 摇杆死区，小于此值视为无操作
// ==================== 语音指令定义（与语音模块完全匹配） ====================
const char forwardCmd   = 1;
const char backwardCmd  = 2;
const char leftCmd      = 3;
const char rightCmd     = 4;
const char stopCmd      = 0;
const char sitDownCmd   = 5;
const char lieDownCmd   = 6;
const char danceCmd     = 7;

// ==================== 硬件对象 ====================
Servo servoFL; // 前左
Servo servoFR; // 前右
Servo servoBL; // 后左
Servo servoBR; // 后右

// 创建串口1对象
HardwareSerial uart1(1);
HardwareSerial uart2(2);

// 创建 OLED 对象
Adafruit_SSD1306 display(SCREEN_WIDTH, SCREEN_HEIGHT, &Wire, OLED_RESET);

// ==================== 函数声明 ====================
void moveForward();
void moveBackward();
void turnLeft();
void turnRight();
void stopMovement();
void processCommand(char command);
void sitDown();
void lieDown();
void dance();
void setMotorSpeed(int leftSpeed, int rightSpeed);
void controlByJoystick(int8_t LV, int8_t RH);

// 蓝牙串口功能（完全对应STM32 BlueSerial）
uint8_t BlueSerial_Put(uint8_t Byte);
uint8_t BlueSerial_Get(uint8_t *Byte);
uint16_t BlueSerial_Length(void);
uint8_t BlueSerial_Read(uint16_t Index);
void BlueSerial_ClearBuffer(void);
void BlueSerial_SendString(char *String);
void BlueSerial_Printf(const char *format, ...);
uint8_t BlueSerial_ReceiveFlag(void);
void BlueSerial_Receive(void);
// ==================== OLED字模（保留原样） ====================
static const unsigned char PROGMEM full_gogo_face[] = {
  0x02,0x80,0x00,0x00,0x00,0x00,0x00,0x00,0x00,0x00,0x00,0x00,0x00,0x00,0x00,0x80,
  0x07,0xC0,0x00,0x00,0x00,0x00,0x00,0x00,0x00,0x00,0x00,0x00,0x00,0x00,0x01,0xF0,
  0x1F,0xE0,0x00,0x00,0x00,0x00,0x00,0x00,0x00,0x00,0x00,0x00,0x00,0x00,0x0F,0xF8,
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  0x00,0x00,0x00,0x00,0x00,0x00,0x00,0x00,0x00,0x00,0x00,0x00,0x00,0x00,0x00,0x00
};

static const unsigned char PROGMEM full_did_face[] = {
  0x00,0x00,0x00,0x00,0x00,0x00,0x00,0x00,0x00,0x00,0x00,0x00,0x00,0x00,0x00,0x00,
  0x00,0x00,0x00,0x00,0x00,0x00,0x00,0x00,0x00,0x00,0x00,0x00,0x00,0x00,0x00,0x00,
  0x00,0x00,0x00,0x00,0x00,0x00,0x00,0x00,0x00,0x00,0x00,0x00,0x00,0x00,0x00,0x00,
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  0x00,0x00,0x00,0x00,0x00,0x00,0x00,0x00,0x00,0x00,0x00,0x00,0x00,0x00,0x00,0x00
};

static const unsigned char PROGMEM full_smiley_face[] = {
 0x00,0x00,0x00,0x00,0x00,0x00,0x00,0x00,0x00,0x00,0x00,0x00,0x00,0x00,0x00,0x00,
 0x00,0x00,0x00,0x00,0x00,0x00,0x00,0x00,0x00,0x00,0x00,0x00,0x00,0x00,0x00,0x00,
 0x00,0x00,0x00,0x00,0x00,0x00,0x00,0x00,0x00,0x00,0x00,0x00,0x00,0x00,0x00,0x00,
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 0x00,0x00,0x00,0x00,0x00,0x00,0x00,0x00,0x00,0x00,0x00,0x00,0x00,0x00,0x00,0x00
};

const int ful_width   = 128;
const int full_height = 64;


// ==================== 初始化 ====================
void setup() {
  // 初始化调试串口
  Serial.begin(115200);
  Serial.println("四轮语音机器人控制程序启动");

  // 串口1 = 蓝牙模块（与STM32 USART2功能一致）
  uart1.begin(uart1BaudRate, SERIAL_8N1, uart1RxPin, uart1TxPin);
  Serial.print("蓝牙串口就绪，波特率 ");
  Serial.println(uart1BaudRate);

  // 初始化串口2（语音指令接收）
  uart2.begin(uart2BaudRate, SERIAL_8N1, uart2RxPin, uart2TxPin);

  // 初始化I2C与OLED
  Wire.begin(5, 6);
  if (!display.begin(SSD1306_SWITCHCAPVCC, OLED_ADDR)) {
    Serial.println(F("OLED初始化失败"));
    for (;;);
  }
  display.setRotation(2);
  display.clearDisplay();
  display.drawBitmap(0, 0, full_smiley_face, ful_width, full_height, SSD1306_WHITE);
  display.display();
  delay(1000);

  // 关键：先写入停止值，再挂载舵机引脚，防止上电乱转
  servoFL.write(STOP_SPEED);
  servoFR.write(STOP_SPEED);
  servoBL.write(STOP_SPEED);
  servoBR.write(STOP_SPEED);

  servoFL.attach(servoPinFrontLeft);
  servoFR.attach(servoPinFrontRight);
  servoBL.attach(servoPinBackLeft);
  servoBR.attach(servoPinBackRight);

  BlueSerial_SendString("系统就绪\r\n");
  Serial.println("初始化完成，等待指令");
}

// ==================== 主循环 ====================
void loop() {
  // 1. 语音指令处理（串口2）
  if (uart2.available()) {
    char command = uart2.read();
    // 调试用：收到指令时串口打印，不需要可注释掉
    // Serial.print("收到指令：");
    // Serial.println(command);
    processCommand(command);
  }
  // 2. 蓝牙数据读取入环形缓冲区（对应STM32串口中断接收）
  while (uart1.available()) {
    uint8_t c = uart1.read();
    Serial.print((char)c);  // 所有收到的字节直接打印到串口监视器
    BlueSerial_Put(c);
  }

  if (BlueSerial_ReceiveFlag()) {
    BlueSerial_Receive();
    
    // 调试打印：收到的原始数据包内容
    Serial.print("【收到完整包】");
    Serial.println(BlueSerial_String);

    // 摇杆数据包（不区分大小写）
    if (strcasecmp(BlueSerial_StringArray[0], "joystick") == 0) {
      int8_t LH = atoi(BlueSerial_StringArray[1]);
      int8_t LV = atoi(BlueSerial_StringArray[2]);
      int8_t RH = atoi(BlueSerial_StringArray[3]);
      int8_t RV = atoi(BlueSerial_StringArray[4]);
      
      Serial.print("→ 解析摇杆：LV=");
      Serial.print(LV);
      Serial.print(" RH=");
      Serial.println(RH);
      
      controlByJoystick(LV, RH);
    }
    // 按键数据包（不区分大小写）
    else if (strcasecmp(BlueSerial_StringArray[0], "key") == 0) {
      Serial.print("→ 解析按键：编号");
      Serial.print(BlueSerial_StringArray[1]);
      Serial.print(" 状态：");
      Serial.println(BlueSerial_StringArray[2]);
      
      if (strcmp(BlueSerial_StringArray[2], "up") == 0) {
        int keyNum = atoi(BlueSerial_StringArray[1]);
        if (keyNum >= 0 && keyNum <= 7) {
          Serial.print("→ 执行指令：");
          Serial.println(keyNum);
          processCommand(keyNum);
        }
      }
    }
    else {
      Serial.println("→ 未知指令类型，匹配失败");
    }
  }

  delay(10);
}

// ==================== 蓝牙串口核心函数 ====================
uint8_t BlueSerial_Put(uint8_t Byte) {
  if ((BlueSerial_PutIndex + 1) % BLUE_SERIAL_BUFFER_SIZE == BlueSerial_GetIndex) {
    return 1;
  }
  BlueSerial_Buffer[BlueSerial_PutIndex] = Byte;
  if (BlueSerial_PutIndex >= BLUE_SERIAL_BUFFER_SIZE - 1) {
    BlueSerial_PutIndex = 0;
  } else {
    BlueSerial_PutIndex ++;
  }
  return 0;
}

uint8_t BlueSerial_Get(uint8_t *Byte) {
  if (BlueSerial_GetIndex == BlueSerial_PutIndex) {
    *Byte = 0;
    return 1;
  }
  *Byte = BlueSerial_Buffer[BlueSerial_GetIndex];
  if (BlueSerial_GetIndex >= BLUE_SERIAL_BUFFER_SIZE - 1) {
    BlueSerial_GetIndex = 0;
  } else {
    BlueSerial_GetIndex ++;
  }
  return 0;
}

uint16_t BlueSerial_Length(void) {
  return (BlueSerial_PutIndex + BLUE_SERIAL_BUFFER_SIZE - BlueSerial_GetIndex) % BLUE_SERIAL_BUFFER_SIZE;
}

uint8_t BlueSerial_Read(uint16_t Index) {
  return BlueSerial_Buffer[(BlueSerial_GetIndex + Index) % BLUE_SERIAL_BUFFER_SIZE];
}

void BlueSerial_ClearBuffer(void) {
  uint16_t i;
  for (i = 0; i < BLUE_SERIAL_BUFFER_SIZE; i ++) {
    BlueSerial_Buffer[i] = 0;
  }
  BlueSerial_PutIndex = 0;
  BlueSerial_GetIndex = 0;
}

void BlueSerial_SendString(char *String) {
  uint8_t i;
  for (i = 0; String[i] != '\0'; i ++) {
    uart1.write(String[i]);
  }
}

void BlueSerial_Printf(const char *format, ...) {
  char String[100];
  va_list arg;
  va_start(arg, format);
  vsprintf(String, format, arg);
  va_end(arg);
  BlueSerial_SendString(String);
}

// 检测是否收到完整的 [] 数据包
uint8_t BlueSerial_ReceiveFlag(void) {
  uint8_t Flag = 0;
  uint16_t Length = BlueSerial_Length();
  for (uint16_t i = 0; i < Length; i ++) {
    if (BlueSerial_Read(i) == '[') {
      Flag = 1;
    }
    else if (BlueSerial_Read(i) == ']' && Flag == 1) {
      return 1;
    }
  }
  return 0;
}

// 提取数据包并按逗号分割（优化版：自动过滤空格、换行、回车）
void BlueSerial_Receive(void) {
  uint16_t p = 0, k = 0;
  uint8_t Flag = 0;
  uint16_t Length = BlueSerial_Length();
  for (uint16_t i = 0; i < Length; i ++) {
    uint8_t Byte;
    BlueSerial_Get(&Byte);
    if (Byte == '[') {
      Flag = 1;
      p = 0;
    }
    else if (Byte == ']' && Flag == 1) {
      BlueSerial_String[p] = '\0';
      break;
    }
    else if (Flag == 1) {
      BlueSerial_String[p] = Byte;
      p ++;
    }
  }

  p = 0; k = 0;
  for (uint16_t i = 0; BlueSerial_String[i] != '\0'; i ++) {
    if (BlueSerial_String[i] == ',') {
      BlueSerial_StringArray[p][k] = '\0';
      p ++;
      k = 0;
    }
    else {
      BlueSerial_StringArray[p][k] = BlueSerial_String[i];
      k ++;
    }
  }
  BlueSerial_StringArray[p][k] = '\0';
}


// ==================== 摇杆控制逻辑 ====================
void controlByJoystick(int8_t LV, int8_t RH) {
  // 死区处理
  if (abs(LV) < JOYSTICK_DEAD_ZONE) LV = 0;
  if (abs(RH) < JOYSTICK_DEAD_ZONE) RH = 0;

  // 双回中 = 停止
  if (LV == 0 && RH == 0) {
    stopMovement();
    return;
  }

  // 差速混合：前后速度 + 转向差速
  int leftSpeed = LV - RH;
  int rightSpeed = LV + RH;

  // 限幅 -100 ~ 100
  leftSpeed = constrain(leftSpeed, -100, 100);
  rightSpeed = constrain(rightSpeed, -100, 100);

  // 输出到舵机
  setMotorSpeed(leftSpeed, rightSpeed);

  // 更新OLED状态
  display.clearDisplay();
  display.drawBitmap(0, 0, full_gogo_face, ful_width, full_height, SSD1306_WHITE);
  display.display();
}

// ==================== 舵机速度映射函数 ====================
void setMotorSpeed(int leftSpeed, int rightSpeed) {
  int leftPulse, rightPulse;

  // 左侧舵机脉冲映射
  if (leftSpeed >= 0) {
    leftPulse = map(leftSpeed, 0, 100, STOP_SPEED, LEFT_FORWARD);
  } else {
    leftPulse = map(-leftSpeed, 0, 100, STOP_SPEED, LEFT_BACK);
  }

  // 右侧舵机脉冲映射
  if (rightSpeed >= 0) {
    rightPulse = map(rightSpeed, 0, 100, STOP_SPEED, RIGHT_FORWARD);
  } else {
    rightPulse = map(-rightSpeed, 0, 100, STOP_SPEED, RIGHT_BACK);
  }

  // 安全限幅
  leftPulse = constrain(leftPulse, min(LEFT_FORWARD, RIGHT_BACK), max(LEFT_BACK, RIGHT_FORWARD));
  rightPulse = constrain(rightPulse, min(LEFT_FORWARD, RIGHT_BACK), max(LEFT_BACK, RIGHT_FORWARD));

  servoFL.write(leftPulse);
  servoBL.write(leftPulse);
  servoFR.write(rightPulse);
  servoBR.write(rightPulse);
}


// ==================== 运动控制函数（轮式差速版） ====================
// 前进：四轮同向向前
void moveForward() {
  Serial.println("前进");
  uart1.println("前进");
  display.clearDisplay();
  display.drawBitmap(0, 0, full_gogo_face, ful_width, full_height, SSD1306_WHITE);
  display.display();

  servoFL.write(LEFT_FORWARD);
  servoBL.write(LEFT_FORWARD);
  servoFR.write(RIGHT_FORWARD);
  servoBR.write(RIGHT_FORWARD);
}

// 后退：四轮同向向后
void moveBackward() {
  Serial.println("后退");
  uart1.println("后退");
  display.clearDisplay();
  display.drawBitmap(0, 0, full_gogo_face, ful_width, full_height, SSD1306_WHITE);
  display.display();

  servoFL.write(LEFT_BACK);
  servoBL.write(LEFT_BACK);
  servoFR.write(RIGHT_BACK);
  servoBR.write(RIGHT_BACK);
}

// 左转：左侧停止，右侧前进（差速转弯）
void turnLeft() {
  Serial.println("左转");
  uart1.println("左转");
  display.clearDisplay();
  display.drawBitmap(0, 0, full_gogo_face, ful_width, full_height, SSD1306_WHITE);
  display.display();

  servoFL.write(LEFT_FORWARD);
  servoBL.write(LEFT_FORWARD);
  servoFR.write(STOP_SPEED);
  servoBR.write(STOP_SPEED);
}

// 右转：右侧停止，左侧前进（差速转弯）
void turnRight() {
  Serial.println("右转");
  uart1.println("右转");
  display.clearDisplay();
  display.drawBitmap(0, 0, full_gogo_face, ful_width, full_height, SSD1306_WHITE);
  display.display();

  servoFL.write(STOP_SPEED);
  servoBL.write(STOP_SPEED);
  servoFR.write(RIGHT_FORWARD);
  servoBR.write(RIGHT_FORWARD);
}

// 停止：全部舵机置停止值
void stopMovement() {
  Serial.println("停止");
  uart1.println("停止");
  display.clearDisplay();
  display.drawBitmap(0, 0, full_smiley_face, ful_width, full_height, SSD1306_WHITE);
  display.display();

  servoFL.write(STOP_SPEED);
  servoFR.write(STOP_SPEED);
  servoBL.write(STOP_SPEED);
  servoBR.write(STOP_SPEED);
}

// 坐下：保留显示，执行停止
void sitDown() {
  Serial.println("坐下");
  uart1.println("坐下");
  display.clearDisplay();
  display.drawBitmap(0, 0, full_did_face, ful_width, full_height, SSD1306_WHITE);
  display.display();
  stopMovement();
}

// 趴下：保留显示，执行停止
void lieDown() {
  Serial.println("趴下");
  uart1.println("趴下");
  display.clearDisplay();
  display.drawBitmap(0, 0, full_did_face, ful_width, full_height, SSD1306_WHITE);
  display.display();
  stopMovement();
}

// 跳舞：左右自转交替
void dance() {
  Serial.println("跳舞");
  uart1.println("跳舞");
  display.clearDisplay();
  display.drawBitmap(0, 0, full_smiley_face, ful_width, full_height, SSD1306_WHITE);
  display.display();

  for (int i = 0; i < 4; i++) {
    // 原地左转
    servoFL.write(LEFT_BACK);
    servoBL.write(LEFT_BACK);
    servoFR.write(RIGHT_FORWARD);
    servoBR.write(RIGHT_FORWARD);
    delay(500);
    // 原地右转
    servoFL.write(LEFT_FORWARD);
    servoBL.write(LEFT_FORWARD);
    servoFR.write(RIGHT_BACK);
    servoBR.write(RIGHT_BACK);
    delay(500);
  }
  stopMovement();
}

// ==================== 指令处理 ====================
void processCommand(char command) {
  // 指令过滤：只处理0-7的合法指令，屏蔽上电乱码
  if (command < 0 || command > 7) {
    return;
  }

  Serial.print("执行指令: ");
  Serial.println(command);
  uart1.print("执行指令: ");
  uart1.println(command);

  display.clearDisplay();
  display.setTextColor(SSD1306_WHITE);
  display.setTextSize(1);

  switch (command) {
    case forwardCmd:
      display.drawBitmap(0, 0, full_gogo_face, ful_width, full_height, SSD1306_WHITE);
      display.display();
      moveForward();
      break;
    case backwardCmd:
      display.drawBitmap(0, 0, full_gogo_face, ful_width, full_height, SSD1306_WHITE);
      display.display();
      moveBackward();
      break;
    case leftCmd:
      display.drawBitmap(0, 0, full_gogo_face, ful_width, full_height, SSD1306_WHITE);
      display.display();
      turnLeft();
      break;
    case rightCmd:
      display.drawBitmap(0, 0, full_gogo_face, ful_width, full_height, SSD1306_WHITE);
      display.display();
      turnRight();
      break;
    case stopCmd:
      display.drawBitmap(0, 0, full_smiley_face, ful_width, full_height, SSD1306_WHITE);
      display.display();
      stopMovement();
      break;
    case sitDownCmd:
      display.drawBitmap(0, 0, full_did_face, ful_width, full_height, SSD1306_WHITE);
      display.display();
      sitDown();
      break;
    case lieDownCmd:
      display.drawBitmap(0, 0, full_did_face, ful_width, full_height, SSD1306_WHITE);
      display.display();
      lieDown();
      break;
    case danceCmd:
      display.drawBitmap(0, 0, full_smiley_face, ful_width, full_height, SSD1306_WHITE);
      display.display();
      dance();
      break;
    default:
      break;
  }
}
